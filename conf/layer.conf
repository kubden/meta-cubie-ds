## conf/layer.conf
```bitbake
#We have a conf and classes directory, append to BBPATH
BBPATH .= ":${LAYERDIR}"

# We have a recipes directory, add to BBFILES
BBFILES += "${LAYERDIR}/recipes*/*/*.bb ${LAYERDIR}/recipes*/*/*.bbappend"

BBFILE_COLLECTIONS += "meta-cubie-ds"
BBFILE_PATTERN_meta-cubie-ds := "^${LAYERDIR}/"
BBFILE_PRIORITY_meta-cubie-ds = "10"
```
